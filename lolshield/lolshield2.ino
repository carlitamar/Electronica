#include "Charliplexing.h"
#include "Figure.h"
#include "Font.h"
#include "Myfont.h"

int a[14][9]={
{0,0,0,0,0,0,0,0,0},
{0,0,0,1,1,1,0,0,0},
{0,0,1,0,0,0,1,0,0},
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{0,0,0,1,0,1,0,0,0}
};
int b[14][9]={
{0,0,0,0,0,0,0,0,0},
{0,0,0,0,0,0,0,0,0},
{0,0,0,0,1,1,1,0,0},
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{0,0,0,1,0,0,0,0,0}
};
int c[14][9]={
{0,0,0,0,0,0,0,0,0},
{0,0,0,1,1,1,0,0,0},
{0,0,1,0,0,0,1,0,0},
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{0,0,0,1,0,1,0,0,0}
};
int d[14][9]= {
{0,0,0,0,0,0,0,0,0},
{0,0,0,1,1,1,0,0,0},
{0,0,1,0,0,0,1,0,0},
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{0,0,0,1,0,1,0,0,0}
};
int e[14][9]= {
{0,0,0,0,0,0,0,0,0},
{0,0,0,1,1,1,0,0,0},
{0,0,1,0,0,0,1,0,0},
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{0,0,0,1,0,1,0,0,0}
};

void prendera(){
  for (int i = 13; i >= 0; i--){
    for(int j=0; j <=8; j++){
      LedSign::Set( 13-i,j , a[i][j]*7);
     }
  }  
 }
 void prenderb(){
  for (int i = 13; i >= 0; i--){
    for(int j=0; j <=8; j++){
      LedSign::Set( 13-i,j , b[i][j]*7);
     }
  }  
 }
 void prenderc(){
  for (int i = 13; i >= 0; i--){
    for(int j=0; j <=8; j++){
      LedSign::Set( 13-i,j , c[i][j]*7);
     }
  }  
 }
 void prenderd(){
  for (int i = 13; i >= 0; i--){
    for(int j=0; j <=8; j++){
      LedSign::Set( 13-i,j , d[i][j]*7);
     }
  }  
 }
 void prendere(){
  for (int i = 13; i >= 0; i--){
    for(int j=0; j <=8; j++){
      LedSign::Set( 13-i,j, e[i][j]*7);
     }
  }  
 }

void setup() {
  Serial.begin(9600);
  LedSign::Init(DOUBLE_BUFFER | GRAYSCALE);

}

void loop() {
  if (Serial.available()) {
    while (Serial.available() > 0) {
      char mensaje = Serial.read();
      if (mensaje == 'A'){
        prendera();
        LedSign::Flip(true);
      }
      else if (mensaje == 'B'){
        prenderb();
        LedSign::Flip(true);
      }
      else if (mensaje == 'C'){
        prenderc();
        LedSign::Flip(true);
      }
      else if (mensaje == 'D'){
        prenderd();
        LedSign::Flip(true);
      }
      else if (mensaje == 'E'){
        prendere();
        LedSign::Flip(true);
      }
    }
  }
  
}
